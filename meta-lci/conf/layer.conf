## meta-lci/conf/layer.conf
```bitbake
BBPATH .= ":${LAYERDIR}"

BBFILES += "${LAYERDIR}/recipes-*/*/*.bb \
            ${LAYERDIR}/recipes-*/*/*.bbappend"

BBFILE_COLLECTIONS += "meta-lci"
BBFILE_PATTERN_meta-lci = "^${LAYERDIR}/"
BBFILE_PRIORITY_meta-lci = "6"

LAYERDEPENDS_meta-lci = "core xilinx"
LAYERSERIES_COMPAT_meta-lci = "scarthgap"
```
