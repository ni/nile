## meta-iba/conf/layer.conf
```bitbake
BBPATH .= ":${LAYERDIR}"

BBFILES += "${LAYERDIR}/recipes-*/*/*.bb \
            ${LAYERDIR}/recipes-*/*/*.bbappend"

BBFILE_COLLECTIONS += "meta-iba"
BBFILE_PATTERN_meta-iba = "^${LAYERDIR}/"
BBFILE_PRIORITY_meta-iba = "6"

LAYERDEPENDS_meta-iba = "core"
LAYERSERIES_COMPAT_meta-iba = "scarthgap"
```

## meta-iba/wic/iba.wks
```
# The partition layout defined in this file is tied to various references to these partitions.
# These references include:
#   FIT_IMAGE_PARTITION_A        in kula.conf
#   FIT_IMAGE_PARTITION_B        in kula.conf
#   ROOTFS_PARTITION_A           in kula.conf
#   ROOTFS_PARTITION_B           in kula.conf
#   KERNEL_PARTITION_SIZE        in kula.conf
#   ROOTFS_PARTITION_SIZE        in kula.conf
#   /data partition device path  in fstab
# Note that while not directly tied to any of these partitions, the u-boot environment store
# is configured to reside in unpartitioned space before the first partition. The u-boot
# environment store is configured in a u-boot-xlnx bbappend and in /etc/fw_env.config.
part         --source bootimg-partition                                    --fixed-size=64M   --fstype=vfat  --use-label  --label uboot    --active  --align 1024
part         --source rootfs --rootfs-dir=${IMAGE_ROOTFS}/boot/fit-images  --fixed-size=200M  --fstype=ext4  --use-label  --label kernelA            --align 1024
part         --source rootfs --rootfs-dir=${IMAGE_ROOTFS}/boot/fit-images  --fixed-size=200M  --fstype=ext4  --use-label  --label kernelB            --align 1024
# Partition 4 is an extended partition, which is only used as a container for the remaining
# partitions. It is automatically created when using more than 4 partitions on an MBR disk.
# As a result, the following partitions will be numbered starting at 5.
part         --source rootfs --exclude-path=boot/                          --fixed-size=700M  --fstype=ext4  --use-label  --label rootfsA            --align 1024
part         --source rootfs --exclude-path=boot/                          --fixed-size=700M  --fstype=ext4  --use-label  --label rootfsB            --align 1024
part                                                                       --size=150M        --fstype=ext4  --use-label  --label data               --align 1024
```

## meta-nile-test/conf/layer.conf
```bitbake
# We have a conf and classes directory, add to BBPATH
BBPATH .= ":${LAYERDIR}"

# We have a packages directory, add to BBFILES
BBFILES += "${LAYERDIR}/recipes-*/*/*.bb \
            ${LAYERDIR}/recipes-*/*/*.bbappend"

BBFILE_COLLECTIONS += "meta-nile-test"
BBFILE_PATTERN_meta-nile-test = "^${LAYERDIR}/"
BBFILE_PRIORITY_meta-nile-test = "7"

LAYERDEPENDS_meta-nile-test = "meta-nile"
LAYERSERIES_COMPAT_meta-nile-test = "scarthgap"
```

## meta-nile-test/conf/machine/genesyszu-3eg.conf
```bitbake
#@TYPE: Machine
#@NAME: genesyszu-3eg
#@DESCRIPTION: Machine support for Digilent Genesys ZU 3EG

#### Preamble
MACHINEOVERRIDES =. "${@['', 'genesyszu-3eg:']['genesyszu-3eg' !='${MACHINE}']}"
#### Regular settings follow

# Using the (deprecated) XSCT workflow because the 3eg/oob/master tree just
# has an .xsa in it, and not the appropriate stuff for SDT.
XILINX_WITH_ESW = "xsct"

# The external-hdf recipe really does not make this easy to use a HDF_URI
# that is _not_ a https:// or file://.
HDF_SRCREV = "29cd08a29305d354fbe98c18b698ccb171ae57fc"
HDF_URI = "git://github.com/Digilent/Genesys-ZU-OS.git;protocol=http;branch=3eg/oob/master;rev=${HDF_SRCREV}"
HDF_URI[sha256sum] = "${HDF_SRCREV}"
HDF_URI[S] = "${WORKDIR}/git/project-spec/hw-description"
HDF_NAME = "${S}/system.xsa"

ZYNQMP_SUBMODEL = "-eg"

require conf/machine/genesyszu.inc

### No additional settings should be after the Postamble
#### Postamble
PACKAGE_EXTRA_ARCHS:append = "${@['', ' genesyszu-3eg']['genesyszu-3eg' != '${MACHINE}']}"
```

## meta-nile-test/conf/machine/genesyszu.inc
```bitbake
#@TYPE: Machine
#@NAME: genesyszu
#@DESCRIPTION: Machine support for Digilent Genesys ZU family

#### Preamble
MACHINEOVERRIDES =. "${@['', 'genesyszu:']['genesyszu' !='${MACHINE}']}"
#### Regular settings follow

XILINX_RELEASE_VERSION = "2024.2"

require conf/machine/zynqmp${ZYNQMP_SUBMODEL}-generic.conf

PREFERRED_PROVIDER_virtual/kernel ?= "linux-xlnx"
PREFERRED_VERSION_linux-xlnx = "6.12%"
PREFERRED_VERSION_u-boot-xlnx = "1:2024.01-xilinx-%"
PREFERRED_VERSION_u-boot-tools-xlnx-native = "1:2024.01-xilinx-%"

SPL_BINARY ?= "spl/boot.bin"
UBOOT_ELF = "u-boot"

EXTRA_IMAGEDEPENDS += "\
	u-boot-xlnx-uenv \
	"

IMAGE_BOOT_FILES += "\
	boot.bin \
	uEnv.txt \
	"

### No additional settings should be after the Postamble
#### Postamble
PACKAGE_EXTRA_ARCHS:append = "${@['', ' genesyszu']['genesyszu' != '${MACHINE}']}"
```

## meta-nile/conf/distro/nile.conf
```bitbake
DISTRO = "nile"
DISTRO_NAME = "NI Linux Embedded"
DISTRO_VERSION = "1.0"
DISTRO_CODENAME = "${LAYERSERIES_COMPAT_meta-nile}"

LOCALCONF_VERSION = "2"

SDK_VERSION := "${@'${DISTRO_VERSION}'}"

DISTRO_FEATURES ?= "\
        acl \
        debuginfod \
        ext2 \
        ipsec \
        ipv4 \
        ipv6 \
        multiarch \
        ldconfig \
        lto \
        nfs \
        overlayfs \
        pam \
        pci \
        pni-names \
        ptest \
        seccomp \
        systemd \
        systemd-resolved \
        usbgadget \
        usbhost \
        vfat \
        xattr \
        zeroconf \
"

TCLIBCAPPEND:forcevariable = ""

PACKAGE_CLASSES ?= "package_ipk"

# Enable CVE checks
INHERIT += "cve-check"

require conf/distro/include/no-static-libs.inc
require conf/distro/include/yocto-uninative.inc
require conf/distro/include/security_flags.inc

# Isolate the build system from the host distribution’s C library
INHERIT += "uninative"

# Clean package work directories
INHERIT += "rm_work"

# Create SBOMs in SPDX format
INHERIT += "create-spdx"

# Use systemd for system initialization and journald for logging
INIT_MANAGER = "systemd"
VIRTUAL-RUNTIME_syslog = ""
VIRTUAL-RUNTIME_base-utils-syslog = ""
```

## meta-nile/conf/layer.conf
```bitbake
BBPATH .= ":${LAYERDIR}"

BBFILES += "${LAYERDIR}/recipes-*/*/*.bb \
            ${LAYERDIR}/recipes-*/*/*.bbappend"

BBFILE_COLLECTIONS += "meta-nile"
BBFILE_PATTERN_meta-nile = "^${LAYERDIR}/"
BBFILE_PRIORITY_meta-nile = "6"

LAYERDEPENDS_meta-nile = "core"
LAYERSERIES_COMPAT_meta-nile = "scarthgap"
```

## meta-nile/conf/machine/include/kula/kula-microblaze-psm-features.conf
```bitbake
MACHINE_FEATURES = "cframe cfupmc common csudma emacps iicps iomodule ipipsu qspipsu rtcpsu sdps sysmonpsv tmr-inject tmr-manager trngpsv ttcps uartlite uartpsv usbpsu zdma"
```

## meta-nile/conf/machine/kula-vmk180.conf
```bitbake
#@TYPE: Machine
#@NAME: kula-vmk180
#@DESCRIPTION: VMK180 machine configuration derived from kula.

# Inherit common Kula machine settings.
require conf/machine/kula.conf

# VMK180 SDT source and artifact names.
SDT_URI = "git://dev.azure.com/ni/Users/_git/kula-vivado;protocol=https;branch=vmk180-fixed;rev=22d6b3aa2218d9ecac910834fd7d654fd64ea655"
SDT_URI[S] = "${WORKDIR}/git/qdma_example_kula/generated/sdt"
PDI_PATH = "${PDI_PATH_DIR}/qdma-example-kula-vmk180-20260605.pdi"
```

## meta-nile/conf/machine/kula.conf
```bitbake
#@TYPE: Machine
#@NAME: kula
#@DESCRIPTION: Machine configuration for the kula boards.

BBMULTICONFIG += "kula-microblaze-pmc kula-microblaze-psm"

#### Preamble
MACHINEOVERRIDES =. "${@['', 'kula:']['kula' !='${MACHINE}']}"
#### Regular settings follow
TUNEFILE[microblaze-pmc] = "conf/machine/include/kula/microblaze.inc"
TUNEFILE[microblaze-psm] = "conf/machine/include/kula/microblaze.inc"

# Platform Loader and Manager
PLM_DEPENDS = ""
PLM_MCDEPENDS = "mc::kula-microblaze-pmc:plm-firmware:do_deploy"
PLM_DEPLOY_DIR = "${TMPDIR}-kula-microblaze-pmc/deploy/images/${MACHINE}"

# PSM Firware
PSM_DEPENDS = ""
PSM_MCDEPENDS = "mc::kula-microblaze-psm:psm-firmware:do_deploy"
PSM_FIRMWARE_DEPLOY_DIR = "${TMPDIR}-kula-microblaze-psm/deploy/images/${MACHINE}"

# Set the default (linux) domain device tree
CONFIG_DTFILE_DIR := "${@bb.utils.which(d.getVar('BBPATH'), 'conf/dts/kula')}"
CONFIG_DTFILE ?= "${CONFIG_DTFILE_DIR}/cortexa72-linux.dts"
CONFIG_DTFILE[vardepsexclude] += "CONFIG_DTFILE_DIR"
EXTRA_DT_INCLUDE_FILES += "${CONFIG_DTFILE_DIR}/system-user.dtsi"

# Yocto arm-trusted-firmware(TF-A) variables
TFA_CONSOLE ?= "pl011"
TFA_BL33_LOAD ?= "0x8000000"

# Set DDR Base address for u-boot-xlnx-scr variables
DDR_BASEADDR ?= "0x0"
SKIP_APPEND_BASEADDR ?= "0"

# Yocto KERNEL Variables
UBOOT_ENTRYPOINT  ?= "0x200000"
UBOOT_LOADADDRESS ?= "0x200000"

# Yocto MACHINE_FEATURES Variable
MACHINE_FEATURES += "vdu"

# Required generic machine inclusion
require conf/machine/versal-generic.conf

# This is an 'SDT' based BSP
XILINX_WITH_ESW = "sdt"

# SDT artifacts URL
SDT_URI = "git://dev.azure.com/ni/Users/_git/kula-vivado;protocol=https;branch=main;rev=90775315021334e887dc8d1b3d239ecf079b7d5c"
SDT_URI[S] = "${WORKDIR}/git/kula-base-vck190/generated/sdt"

# Set the system device trees
SYSTEM_DTFILE_DEPENDS = "sdt-artifacts"
SYSTEM_DTFILE_DIR = "${RECIPE_SYSROOT}${datadir}/sdt/${MACHINE}"
SYSTEM_DTFILE = "${SYSTEM_DTFILE_DIR}/system-top.dts"

# Load the dynamic machine features
include conf/machine/include/kula/${BB_CURRENT_MC}-features.conf
LIBXIL_CONFIG = "conf/machine/include/kula/${BB_CURRENT_MC}-libxil.conf"

# Versal PDI
PDI_PATH_DEPENDS = "sdt-artifacts"
PDI_PATH_DIR = "${RECIPE_SYSROOT}${datadir}/sdt/${MACHINE}"
PDI_PATH = "${PDI_PATH_DIR}/kula-base-vck190-20251027-2.pdi"

# Update bootbin to use proper device tree
BIF_PARTITION_IMAGE[device-tree] = "${RECIPE_SYSROOT}/boot/devicetree/${@os.path.basename(d.getVar('CONFIG_DTFILE').replace('.dts', '.dtb'))}"

# Remap boot files to ensure the right device tree is listed first
IMAGE_BOOT_FILES =+ "devicetree/${@os.path.basename(d.getVar('CONFIG_DTFILE').replace('.dts', '.dtb'))}"

#### No additional settings should be after the Postamble
#### Postamble
PACKAGE_EXTRA_ARCHS:append = "${@['', ' kula']['kula' != '${MACHINE}']}"
```

## meta-nile/wic/kula.wks
```
part         --source rootfs --change-directory=boot  --fixed-size=64M   --fstype=vfat  --use-label  --label boot    --active  --align 4
part                                                  --fixed-size=200M  --fstype=ext4  --use-label  --label kernelA           --align 4
part                                                  --fixed-size=200M  --fstype=ext4  --use-label  --label kernelB           --align 4
part  /      --source rootfs --exclude-path=boot/     --fixed-size=700M  --fstype=ext4  --use-label  --label rootfsA           --align 4
part  /      --source rootfs --exclude-path=boot/     --fixed-size=700M  --fstype=ext4  --use-label  --label rootfsB           --align 4
part  /data                                           --size=150M        --fstype=ext4  --use-label  --label data              --align 4
```
